/**
 * @file ssd1306.c
 * @brief Lightweight SSD1306 128x64 OLED driver implementation.
 *
 * Framebuffer model: 1024-byte array indexed as [page * 128 + col].
 * ssd1306_flush() sends it all in one I2C transaction with a 0x40 prefix byte.
 */

#include "drivers/ssd1306.h"
#include <string.h>
#include <stddef.h>

/* ── Built-in 5x7 font (ASCII 32-127) ────────────────────────────────────── */
/* Each character is 5 bytes wide. We render with 1 pixel gap → 6 cols/char. */
static const uint8_t s_font5x7[][5] = {
    {0x00,0x00,0x00,0x00,0x00}, /* ' ' 32 */
    {0x00,0x00,0x5F,0x00,0x00}, /* '!' 33 */
    {0x00,0x07,0x00,0x07,0x00}, /* '"' 34 */
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    {0x08,0x1C,0x2A,0x08,0x08}, /* DEL 127 */
};

/* ── SSD1306 command byte sequences ──────────────────────────────────────── */
/* Co=0, D/C#=0 → all following bytes are commands */
#define SSD1306_CMD_PREFIX  0x00U

static const uint8_t s_init_cmds[] = {
    0xAE,       /* Display OFF                        */
    0xD5, 0x80, /* Set display clock divide / osc     */
    0xA8, 0x3F, /* Set multiplex ratio (64-1)         */
    0xD3, 0x00, /* Set display offset = 0             */
    0x40,       /* Set display start line = 0         */
    0x8D, 0x14, /* Charge pump ON                     */
    0x20, 0x00, /* Memory addressing mode: Horizontal */
    0xA1,       /* Segment remap (col 127 → SEG0)     */
    0xC8,       /* COM scan direction: remapped       */
    0xDA, 0x12, /* Set COM pins hardware config       */
    0x81, 0xCF, /* Set contrast                       */
    0xD9, 0xF1, /* Set pre-charge period              */
    0xDB, 0x40, /* Set Vcomh deselect level           */
    0xA4,       /* Output follows RAM                 */
    0xA6,       /* Normal display (not inverted)      */
    0xAF,       /* Display ON                         */
};

/* ── Framebuffer ──────────────────────────────────────────────────────────── */
/*
 * Prefixed with 0x40 (data stream indicator) so we can hand it directly
 * to HAL_I2C_Master_Transmit without an extra copy.
 */
static uint8_t s_buf[1 + SSD1306_BUF_SIZE];  /* [0]=0x40, [1..1024]=pixels */

/* ── Internal helpers ─────────────────────────────────────────────────────── */
static HAL_StatusTypeDef send_cmd_buf(I2C_HandleTypeDef *hi2c,
                                       const uint8_t *cmds, uint16_t len)
{
    /* Prepend 0x00 (command stream prefix) */
    uint8_t pkt[32];
    pkt[0] = SSD1306_CMD_PREFIX;
    if (len > sizeof(pkt) - 1) len = sizeof(pkt) - 1;
    for (uint16_t i = 0; i < len; i++) pkt[1 + i] = cmds[i];
    return HAL_I2C_Master_Transmit(hi2c, SSD1306_I2C_ADDR,
                                    pkt, len + 1, 50);
}

static HAL_StatusTypeDef set_column_page_range(I2C_HandleTypeDef *hi2c)
{
    /* Set column address 0-127 and page address 0-7 for full-screen flush */
    const uint8_t cmds[] = {
        0x21, 0x00, 0x7F,   /* Column address: 0 to 127 */
        0x22, 0x00, 0x07,   /* Page address:   0 to 7   */
    };
    return send_cmd_buf(hi2c, cmds, sizeof(cmds));
}

/* ── Public API implementation ────────────────────────────────────────────── */

HAL_StatusTypeDef ssd1306_init(I2C_HandleTypeDef *hi2c)
{
    s_buf[0] = 0x40U;  /* Data stream prefix — set once, never changes */
    ssd1306_clear();
    return send_cmd_buf(hi2c, s_init_cmds, sizeof(s_init_cmds));
}

void ssd1306_clear(void)
{
    /* Zero only the pixel portion; leave s_buf[0] = 0x40 intact */
    memset(&s_buf[1], 0x00, SSD1306_BUF_SIZE);
}

HAL_StatusTypeDef ssd1306_flush(I2C_HandleTypeDef *hi2c)
{
    HAL_StatusTypeDef st = set_column_page_range(hi2c);
    if (st != HAL_OK) return st;
    /* Send the entire framebuffer in one burst. +1 for the 0x40 prefix byte. */
    return HAL_I2C_Master_Transmit(hi2c, SSD1306_I2C_ADDR,
                                    s_buf, 1 + SSD1306_BUF_SIZE, 200);
}

void ssd1306_puts(uint8_t col, uint8_t page, const char *str)
{
    if (!str || page >= SSD1306_PAGES) return;

    while (*str) {
        uint8_t c = (uint8_t)*str++;
        if (c < 32 || c > 127) c = '?';

        /* Each glyph is 5 pixels wide + 1 blank gap = 6 pixels total */
        if (col + 6 > SSD1306_WIDTH) break;

        const uint8_t *glyph = s_font5x7[c - 32];
        uint16_t base = (uint16_t)page * SSD1306_WIDTH + col;

        /* +1 because s_buf[0] is the 0x40 data prefix */
        s_buf[1 + base + 0] = glyph[0];
        s_buf[1 + base + 1] = glyph[1];
        s_buf[1 + base + 2] = glyph[2];
        s_buf[1 + base + 3] = glyph[3];
        s_buf[1 + base + 4] = glyph[4];
        s_buf[1 + base + 5] = 0x00;    /* 1-pixel inter-character gap */

        col += 6;
    }
}
